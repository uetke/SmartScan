'<ADbasic Header, Headerversion 001.001>
'<Header End>
' globals.inc
' 
' ##################################################################
' #            THIS FILE WAS AUTOMATICALLY GENERATED               #
' #               EDIT BY HAND AT YOUR OWN PERIL                   #
' ##################################################################
' 
' Generated on Mon 08 Aug 2016 at 16:51
' by LION@MEETPC113 using adwin_constants.py

#define data_QPDx data_176
#define data_dev_params data_198
#define data_QPDy data_175
#define data_Time data_176
#define data_QPDz data_174
#define data_Scan_params data_199
#define data_Timetrace data_177
#define par_Output_value par_73
#define par_Case par_80
#define par_Port par_74
#define par_Dev_type par_72
#define par_Delay par_70
#define par_Input_value par_75
#define par_Num_devs par_71
#define par_Num_ticks par_78
#define par_Pix_done par_79
#define data_Counter2 data_179
#define data_Analog6 data_187
#define data_Analog11 data_192
#define data_Analog3 data_184
#define data_Counter3 data_180
#define data_Analog10 data_191
#define data_Counter4 data_181
#define data_Analog7 data_188
#define data_Analog8 data_189
#define data_Analog4 data_185
#define data_Digin4 data_170
#define data_Digin1 data_173
#define data_Digin5 data_169
#define data_Digin8 data_166
#define data_Scan_data data_200
#define data_Analog5 data_186
#define data_Analog16 data_197
#define data_Digin3 data_171
#define data_Counter1 data_178
#define data_Digin2 data_172
#define data_Analog14 data_195
#define data_Analog12 data_193
#define data_Analog13 data_194
#define data_Analog9 data_190
#define data_Analog2 data_183
#define data_Digin6 data_168
#define data_Digin7 data_167
#define data_Analog1 data_182
#define data_Analog15 data_196
#define CASE_DIG_CLEAR 7
#define CASE_ADC 2
#define CASE_DIG_IN 5
#define CASE_ACQ 3
#define CASE_SCAN 4
#define CASE_ACQ_MULTI 33
#define CASE_DIG_OUT 6
#define CASE_DAC 1
